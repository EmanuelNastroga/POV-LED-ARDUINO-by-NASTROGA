/*
  POV LED - código para controle de leds junto ao persistencia visual.

  funçoes para acesso igual a um display

  Data 18/09/2016 Prudentópolis-Pr Brasil

  *criador : Emanuel nastroga.
  *
  *ANALISE e DESENVOLVIMENTO de SISTEMAS .ADS
  * 
  *emanuelnastroga@hotmail.com
  *
  *Para fins educacionais.
  *
  *
  
*/



 byte ascii[128][8] = {
    { 0x00, 0x00, 0x00, 0x00, 0x00, 0x00, 0x00, 0x00},   // U+0000 (nul)
    { 0x00, 0x00, 0x00, 0x00, 0x00, 0x00, 0x00, 0x00},   // U+0001
    { 0x00, 0x00, 0x00, 0x00, 0x00, 0x00, 0x00, 0x00},   // U+0002
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    { 0x00, 0x00, 0x00, 0x00, 0x00, 0x00, 0x00, 0x00}    // U+007F

};
#define clkPin 17
#define datPin 18
#define latPin 19
#define irdPin 5 //pin infravermelho 


struct Pov{
private:
        int pinClk;
        int pinLatch;
        int pinData;
        //char selectedChar;
        char frase1[15];
        char frase2[15];
        int  draw[320];


public:
        Pov(int clk, int dat,int lat)
        {
          pinData  = dat;
          pinClk   = clk;
          pinLatch = lat;
          pinMode(pinData, OUTPUT);
          pinMode(pinClk,  OUTPUT);
          pinMode(pinLatch,OUTPUT);
          
        }

        void print(int x,int y,String text)
        {
          int Length=text.length();//informa quantos caracteres
          int limitX;
          
          if(y>1)
          {
            y=1;
          }
          
          if(x+Length>15)
          {
            limitX=15;
          }
          
          else
          {
            limitX=x+Length;
          }
                    
          //for(int line=x; line<x+Length; line++)
          for(int line=x; line<limitX; line++)
          {
            if(y==0)
            {
              frase1[line]=text.charAt(line-x);
            }
            else if(y==1)
            {
              frase2[line]=text.charAt(line-x);
            }
          }
 
        }

        void write(int vetorDraw[])
        {
          for(int i=0; i<160; i++)
          {
             draw[i]=vetorDraw[i];
             draw[i+160]=vetorDraw[i+160];           
          }
        }

        void update()
        {    
          for(int caracter=0; caracter<15; caracter++)
          {
            for(int asciiBits=0; asciiBits<8; asciiBits++)
            {
              digitalWrite(pinLatch,LOW);
              shiftOut(pinData,pinClk,MSBFIRST,ascii[frase1[caracter]][asciiBits]);
              shiftOut(pinData,pinClk,MSBFIRST,ascii[frase2[caracter]][asciiBits]);
              digitalWrite(pinLatch,HIGH);
              delayMicroseconds(500);
                  
            }
          }
        } 

          void clear()
          {
             
              digitalWrite(pinLatch,LOW);
              shiftOut(pinData,pinClk,MSBFIRST,0);
              shiftOut(pinData,pinClk,MSBFIRST,0);
              digitalWrite(pinLatch,HIGH);
          }
        

  
};

Pov propeller(clkPin,datPin,latPin);//(int clk, int dat,int lat)

void setup() 
{
  propeller.print(0,0,"NASTROGA TECH");
  propeller.print(0,1," * EMANUEL * ");
  propeller.clear();
pinMode(irdPin,INPUT_PULLUP);
}

void loop() 
{
  
 if(digitalRead(irdPin)==LOW)
 {
     propeller.update();
     propeller.clear();
 }

}
